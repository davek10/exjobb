## CMakeLists.txt
```
# SPDX-License-Identifier: Apache-2.0

cmake_minimum_required(VERSION 3.20.0)
find_package(Zephyr REQUIRED HINTS $ENV{ZEPHYR_BASE})
project(observer)

target_sources(app PRIVATE
  src/main.c
  src/observer.c
  src/mitm.c
  src/my_adv.c
  src/db.c
  src/my_uart.c
  src/myutil.c
)
```

## prj.conf
```kconfig
CONFIG_BT=y
CONFIG_BT_CENTRAL=y
CONFIG_BT_PERIPHERAL=y
CONFIG_LOG=y

CONFIG_BT_SMP=y
CONFIG_BT_SMP_APP_PAIRING_ACCEPT=y
CONFIG_BT_FIXED_PASSKEY=y
CONFIG_BT_PASSKEY_KEYPRESS=y

CONFIG_BT_MAX_CONN=2
CONFIG_BT_MAX_PAIRED=2

# Enable Extended Scanning
CONFIG_BT_EXT_ADV=y
CONFIG_BT_EXT_SCAN_BUF_SIZE=1650

# Zephyr Bluetooth LE Controller needs 16 event buffers to generate Extended
# Advertising Report for receiving the complete 1650 bytes of data
CONFIG_BT_BUF_EVT_RX_COUNT=16

# Set maximum scan data length for Extended Scanning in Bluetooth LE Controller
CONFIG_BT_CTLR_SCAN_DATA_LEN_MAX=1650

# Increase Zephyr Bluetooth LE Controller Rx buffer to receive complete chain
# of PDUs
CONFIG_BT_CTLR_RX_BUFFERS=9

CONFIG_HEAP_MEM_POOL_SIZE=65536	
CONFIG_SYSTEM_WORKQUEUE_STACK_SIZE=2048

CONFIG_BT_ID_MAX=5
#CONFIG_DEBUG_OPTIMIZATIONS=y

CONFIG_BT_PRIVACY=y

CONFIG_BT_GATT_CLIENT=y
CONFIG_BT_GATT_DYNAMIC_DB=y
CONFIG_BT_DEVICE_NAME_DYNAMIC=y
CONFIG_BT_DEVICE_APPEARANCE_DYNAMIC=y
CONFIG_BT_L2CAP_TX_BUF_COUNT=8

CONFIG_BT_GATT_LOG_LEVEL_DBG=n
#CONFIG_BT_ATT_LOG_LEVEL_DBG=y
CONFIG_BT_SMP_LOG_LEVEL_DBG=n



CONFIG_BT_CTLR_PHY_CODED=y
CONFIG_BT_CTLR_ADV_EXT=y

CONFIG_LOG_BUFFER_SIZE=32768

CONFIG_BT_LL_SW_SPLIT=y
#CONFIG_BT_LL_SOFTDEVICE=y
CONFIG_BT_RX_STACK_SIZE=2200
CONFIG_DEBUG_THREAD_INFO=y
CONFIG_DEBUG_OPTIMIZATIONS=y
#CONFIG_BT_RECV_BLOCKING=y
CONFIG_BT_USER_PHY_UPDATE=y

CONFIG_SERIAL=y
CONFIG_UART_INTERRUPT_DRIVEN=y
```

## src/main.c
```c
/*
 * Contains code inspired by and/or copied and modified from the Zephyr BLE-Periphiral example avalible at:
 * https://github.com/zephyrproject-rtos/zephyr/blob/main/samples/bluetooth/peripheral/src/main.c
 *
 * Original copyright:
 *
 * Copyright (c) 2015-2016 Intel Corporation
 *
 * SPDX-License-Identifier: Apache-2.0
 */
#include <string.h>
#include <zephyr/bluetooth/bluetooth.h>
#include <zephyr/bluetooth/buf.h>
#include <zephyr/bluetooth/hci.h>
#include <zephyr/logging/log.h>
#include <zephyr/kernel.h>
//#include <zephyr/bluetooth/controller.h>
#include "my_adv.h"
#include "db.h"
#include "mitm.h"
#include "my_uart.h"
#include "observer.h"
#include "errno.h"
#include "myutil.h"
#include <zephyr/bluetooth/addr.h>
#include <zephyr/sys/atomic.h>

//#define MY_PUBLIC_FIX

LOG_MODULE_REGISTER(log1, APP_LOG_LEVEL);

struct k_sem my_bt_enable_sem;
K_SEM_DEFINE(my_bt_enable_sem,0,1);

struct k_sem my_auth_sem;
K_SEM_DEFINE(my_auth_sem,0,1);
atomic_val_t my_auth_flag = ATOMIC_INIT(0);

enum command{
	LIST_HANDLES,
	LIST_CONNECTIONS,
	LIST_DEVICES,
	BLOCK,
	ALTER,
	EXIT,
	ERROR,
	TARGET,
	START,
	REPLACE,
	BOND,
	RECONNECT,
};


static void auth_passkey_display(struct bt_conn *conn, unsigned int passkey)
{
	char addr[BT_ADDR_LE_STR_LEN];

	bt_addr_le_to_str(bt_conn_get_dst(conn), addr, sizeof(addr));

	LOG_INF("Passkey for %s: %06u\n", addr, passkey);
}

static void auth_cancel(struct bt_conn *conn)
{
	char addr[BT_ADDR_LE_STR_LEN];

	bt_addr_le_to_str(bt_conn_get_dst(conn), addr, sizeof(addr));

	LOG_INF("Pairing cancelled: %s\n", addr);
}

static void auth_passkey_entry(struct bt_conn *conn){
	LOG_INF("");
	LOG_INF("passkey_entry");
	unsigned int passkey;
	#ifndef MY_CPY_USER_PASSKEY
	atomic_set(&my_auth_flag,1);
	k_sem_take(&my_auth_sem,K_FOREVER);
	#endif
	passkey = my_mitm_get_passkey();
	LOG_INF("retrieved passkey: %u",passkey);
	
	int err = bt_conn_auth_passkey_entry(conn, passkey);
	if(err){
		LOG_ERR("AUTH_PASSKEY_ENTRY ERROR %d",err);
	}
}

static void auth_pairing_confirm(struct bt_conn *conn)
{
	LOG_DBG("unhandled pairing!");
	int err = bt_conn_auth_pairing_confirm(conn);
	if(err){
		LOG_ERR("COULD NOT CONFIRM PAIRING");
	}
}

static struct bt_conn_auth_cb auth_cb_display = {
	.passkey_display = auth_passkey_display,
	.passkey_entry = auth_passkey_entry,
	.cancel = auth_cancel,
	.pairing_confirm=auth_pairing_confirm,
	
};

void my_create_bond(uint32_t dir){

	if(dir == 1)
	{
		int err = bt_conn_set_security(my_get_main_conn(),BT_SECURITY_L4);
		if(err){
			LOG_ERR("COULD NOT PAIR/BOND WITH DEVICE reason: %d", err);
		}
	}
	return;
}

void list_devices(){
	my_obs_print_blocklist();
	my_clear_block();
}

void lst_handle_cb(uint16_t handle,struct bt_gatt_attr *attr, void *data){
	
	char uuid_str[BT_UUID_STR_LEN];
	bt_uuid_to_str(attr->uuid, uuid_str, BT_UUID_STR_LEN);
	LOG_INF("handle: %u, uuid: %s", handle, uuid_str);
}

void lst_conn_cb(struct bt_conn *conn, void *data){
	struct bt_conn_info info;
	bt_conn_get_info(conn, &info);
	char addr[BT_ADDR_LE_STR_LEN];
	bt_addr_le_to_str(info.le.src, addr, BT_ADDR_LE_STR_LEN);
	print_uart(addr);
	print_uart("\r\n");
}

static void my_bt_enable_cb(){
		k_sem_give(&my_bt_enable_sem);
		return ;
	}

void list_handles()
{
	my_db_foreach(lst_handle_cb, NULL);
}

void list_connections(){
	bt_conn_foreach(BT_CONN_TYPE_LE,lst_conn_cb,NULL);
}

void my_disconnect_all_cb(struct bt_conn *conn, void *data)
{
	bt_conn_disconnect(conn,BT_HCI_ERR_REMOTE_USER_TERM_CONN);
}

	void my_exit()
	{
		bt_conn_foreach(BT_CONN_TYPE_LE, my_disconnect_all_cb, NULL);
		bt_le_adv_stop();
	}

	

	size_t my_str_to_bytes(char *str, uint8_t **data){
		
		size_t len = strnlen(str, UART_MSG_SIZE);
		size_t byte_len = (len+1)/2;
		uint8_t *tmp_data = k_malloc(byte_len);
		for(int i = byte_len-1; i>=0 ; i--){
			uint8_t b1,b2;
			
			int err = char2hex(str[2*i],&b1);
			if(2*i+1 < len ){
				err = char2hex(str[2 * i + 1], &b2);
				b1 <<=4;
			}else{
				b2 = 0;
			}
			tmp_data[i] = b1 | b2;
			LOG_DBG("char: %c",str[i]);
			LOG_HEXDUMP_DBG(&tmp_data[i],1,"data:");
		}
		*data = tmp_data;
		LOG_HEXDUMP_DBG(tmp_data,len,"bytes: ");
		return byte_len;
	}



	enum command handle_command(char *buf)
	{
		char *tmp;
		char *iter = strtok_r(buf, " ", &tmp);

		if (strncmp(iter, "list", sizeof("list")) == 0)
		{
			LOG_DBG("in list");
			iter = strtok_r(NULL, " ", &tmp);
			LOG_DBG("iter: %s", iter);
			// iter = strtok_r(iter,NULL,&tmp);
			LOG_DBG("iter2: %s", iter);

			if (strncmp(iter, "handles", sizeof("handles")) == 0)
			{
				return LIST_HANDLES;
			}
			else if (strncmp(iter, "connections", sizeof("connections")) == 0)
			{
				return LIST_CONNECTIONS;
			}
			else if (strncmp(iter, "devices", sizeof("devices")) == 0)
			{
				return LIST_DEVICES;
			}
			return ERROR;
		}
		else if (strncmp(iter, "start", sizeof("start")) == 0)
		{
			return START;
		}
		else if (strncmp(iter, "exit", sizeof("exit")) == 0)
		{

			return EXIT;
		}
		else if (strncmp(iter, "block", sizeof("block")) == 0)
		{
			iter = strtok_r(NULL, " ", &tmp);
			uint32_t nr = my_str_to_uint(iter, UART_MSG_SIZE);
			iter = strtok_r(NULL, " ", &tmp);
			uint32_t dir = my_str_to_uint(iter, UART_MSG_SIZE);
			my_add_rule((dir != 0), nr, 0, 0,0);
			return BLOCK;
		}
		else if (strncmp(iter, "bond", sizeof("bond")) == 0)
		{
			iter = strtok_r(NULL, " ", &tmp);
			uint32_t nr = my_str_to_uint(iter, UART_MSG_SIZE);
			my_create_bond(nr);
			return BOND;
		}
		else if (strncmp(iter, "replace", sizeof("replace")) == 0)
		{
			iter = strtok_r(NULL, " ", &tmp);
			uint32_t nr = my_str_to_uint(iter, UART_MSG_SIZE);
			iter = strtok_r(NULL, " ", &tmp);
			uint32_t dir = my_str_to_uint(iter, UART_MSG_SIZE);
			iter = strtok_r(NULL, " ", &tmp);

			
			uint8_t *new_val;
			size_t len = my_str_to_bytes(iter, &new_val);
			LOG_DBG("len : %u",len);
			LOG_HEXDUMP_DBG((void *)new_val, len, "returned bytes: ");
			my_add_rule((dir != 0), nr, true, new_val, len);
			return REPLACE;
		}
		else if (strncmp(iter, "set_target", sizeof("set_target")) == 0)
		{
			iter = strtok_r(NULL, " ", &tmp);
			char addr[BT_ADDR_LE_STR_LEN];
			strncpy(addr, iter, BT_ADDR_LE_STR_LEN);
			LOG_DBG("addr = %s", addr);
			iter = strtok_r(NULL, " ", &tmp);
			char type[sizeof("random")];
			strncpy(type, iter, sizeof(type));
			LOG_DBG("type = %s", type);
			set_my_target(addr, type);
			return TARGET;
		}
		else if (strncmp(iter, "reconnect", sizeof("reconnect")) == 0)
		{
			iter = strtok_r(NULL, " ", &tmp);
			const uint8_t max_conn_str_len = (CONFIG_BT_MAX_CONN %10)+3;
			char id[max_conn_str_len];
			strncpy(id, iter, max_conn_str_len);
			LOG_DBG("id = %s", id);
			uint32_t uint_id = my_str_to_uint(id,max_conn_str_len);
			my_adv_reconnect(uint_id);

			return RECONNECT;
		}

		else
		{
			return ERROR;
		}
	}

int my_start(){
	int err;
	LOG_INF("starting module ...");

	err = k_sem_take(&target_sem, K_FOREVER);

	if(err){
		LOG_ERR("no target set");
		return err;
	}

	err = bt_le_scan_stop();
	if (err)
	{
		LOG_ERR("Bluetooth stop scanning failed (err %u)\n", err);
		return err;
	}

	int _identity_id=0;
	//bt_addr_le_t *current_addr = BT_ADDR_ANY;
	//_identity_id = bt_id_create(NULL, NULL);
#ifdef MY_PUBLIC_FIX

	LOG_INF("creating profile");
	const bt_addr_le_t* _addr = get_my_target();
	if (_addr->type != BT_ADDR_LE_RANDOM ||
		!BT_ADDR_IS_STATIC(&_addr->a))
	{
		LOG_ERR("WARNING dangerous type ahead");
		LOG_DBG("is_static_addr = %u", BT_ADDR_IS_STATIC(&_addr->a));

		err = bt_disable();
		bt_ctlr_set_public_addr(&_addr->a.val);
		
		err = bt_enable(my_bt_enable_cb);
		k_sem_take(&my_bt_enable_sem,K_FOREVER);

		
		_identity_id = 0;
	}
	else
	{

		//_identity_id = bt_id_create(&target_mitm_info.addr, NULL);
		if (_identity_id < 0)
		{
			LOG_ERR("Unable to create new bluetooth identity (err %d)\n", _identity_id);
			return _identity_id;
		}
	}
	//set_my_mitm_address_id(_identity_id);
// endif MY_PUBLIC_FIX
#endif

	LOG_INF("Creating main connection to target ...\n");

	target_mitm_info.conn_param = *BT_LE_CONN_PARAM_DEFAULT;
	struct bt_conn *_tmp_conn;
	char tmpp [BT_ADDR_LE_STR_LEN];
	bt_addr_le_to_str(get_my_target(),tmpp,sizeof(tmpp));
	LOG_DBG("target type: %u, data: %s",get_my_target()->type,tmpp);
	LOG_DBG("iscoded: %u",my_mitm_get_is_coded());
	bool is_coded = my_mitm_get_is_coded();
	uint32_t opt = (is_coded ? BT_CONN_LE_OPT_CODED : BT_CONN_LE_OPT_NONE);
	
	target_mitm_info.create_param = *BT_CONN_LE_CREATE_PARAM(opt,
																			  BT_GAP_SCAN_FAST_INTERVAL,
																			  BT_GAP_SCAN_FAST_INTERVAL);
	
	err = bt_conn_le_create(get_my_target(), &target_mitm_info.create_param, &target_mitm_info.conn_param, &_tmp_conn);
	if(err){
		LOG_ERR("failed to connect to target err: %d ",err);
	}
	k_sem_take(&adv_sem, K_FOREVER);
	my_start_discovery();

	LOG_INF("main connection established waiting for discovery process ...\n");
	k_sem_take(&adv_sem, K_FOREVER);
	/*MY_MAN_BUF*/
	//LOG_DBG("subscribing to attributes");
	//err = my_adv_subscribe_to_all();

	my_adv_wait_for_appearance();

	LOG_INF("Starting MITM module ...\n");
	err = my_mitm_start_ad();

	if (err)
	{
		LOG_ERR("failing to activate mitm module (err %d)\n", err);
		return;
	}
	k_sem_take(&target_sem, K_FOREVER);
	LOG_INF("MITM module started \n");
}

void main(void)
{
	int err;

	LOG_INF("initializing modules ...");
	my_init_mitm();

	err = my_uart_init();
	if(err){
		LOG_ERR("Uart init failed (err %d)\n", err);
	}


	err = bt_enable(NULL);
	if (err) {
		LOG_ERR("Bluetooth init failed (err %d)\n", err);
		return;
	}
	
	err = bt_conn_auth_cb_register(&auth_cb_display);
	if(err){
		LOG_ERR("Uart init failed (err %d)\n", err);
	}

	LOG_INF("Starting Observer");
	err = observer_start();
	if (err){
		LOG_ERR("Bluetooth observer failed (err %d)\n", err);
		return;
	}

	char tx_buf[UART_MSG_SIZE];
	bool loop = true;
	enum command cmd;

	LOG_INF("Observer started, uart ui waiting for commands: ");
	while (loop && k_msgq_get(&uart_msgq, &tx_buf, K_FOREVER) == 0)
	{
		print_uart(tx_buf);
		print_uart("\r\n");
		if(atomic_get(&my_auth_flag)){
			LOG_INF("in auth mode");
			my_mitm_set_passkey_c(&tx_buf, UART_MSG_SIZE);
			atomic_set(&my_auth_flag,0);
			k_sem_give(&my_auth_sem);
			continue;
		}
		cmd = handle_command(tx_buf);
		LOG_DBG("cmd = %u", cmd);

		switch (cmd)
		{
		case START:
			set_my_target_set(true);
			my_start();
			break;

			case ERROR:
			print_uart("unknown command \r\n");
			break;

		case EXIT:
			print_uart("exiting \r\n");
			loop = false;
			my_exit();
			break;

		case LIST_CONNECTIONS:
			list_connections();
			break;
		case LIST_HANDLES:
			list_handles();
			break;
		case LIST_DEVICES:
			list_devices();
			break;
			
		default:
			print_uart("command executed \r\n");
			break;
		}
	}

	//err = set_my_target("F7:E1:36:7C:5B:AB", "random");

	LOG_INF("Exiting %s thread.\n", __func__);
}
```

## src/adv.c
```c
#include "adv.h"
#include <zephyr/types.h>
#include <zephyr/logging/log.h>
#include <zephyr/bluetooth/conn.h>
#include<zephyr/bluetooth/gatt.h>
#include "myutil.h"
#include <zephyr/bluetooth/uuid.h>
#include <zephyr/logging/log_ctrl.h>
#include "db.h"

#define ALLOW_DISCOVERY
//#define MYBLOCKREAD

LOG_MODULE_DECLARE(log1, LOG_LEVEL_DBG);
#define CHECK_RULES

struct k_sem disc_sem;
K_SEM_DEFINE(disc_sem, 0, K_SEM_MAX_LIMIT);
K_SEM_DEFINE(adv_sem, 0, 1);

sys_slist_t my_attr_list = {NULL, NULL};

atomic_t empty_loop = ATOMIC_INIT(0);
atomic_t my_attr_list_ctr = ATOMIC_INIT(0);
atomic_t my_sem_counter = ATOMIC_INIT(0);

struct bt_conn *main_conn = NULL;

struct bt_gatt_discover_params *chrc_params, *ccc_params;

struct bt_gatt_service *_service;

struct my_rule my_rules[MAX_RULES];
int num_rules = 0;


int my_add_rule(bool dir, uint16_t handle, bool set_new_val, int new_val ){

    if(num_rules == MAX_RULES){
        return -1;
    }
    struct my_rule *tmp = &my_rules[num_rules];

    tmp->dir = dir;
    tmp->handle = handle;
    tmp->set_new_val = set_new_val;
    tmp->new_val = new_val;

    num_rules++;
    return 0;
}

int my_check_rules(uint8_t dir, uint16_t handle){
    if(!num_rules){
        return 0;
    }
    for(int i =0; i < num_rules; i++){
        struct my_rule *tmp = &my_rules[i];
        if(tmp->dir == dir && tmp->handle == handle){
            return -1;
        }
    }
    return 0;
}

static uint8_t tmp_func(const struct bt_gatt_attr *attr, uint16_t handle, void *user_data)
{

    if(!attr){
        return BT_GATT_ITER_STOP;
    }

    char uuid_str[BT_UUID_STR_LEN];
    bt_uuid_to_str(attr->uuid, uuid_str, BT_UUID_STR_LEN);
    
    LOG_DBG("found attr with uuid: %s, handle: %u", uuid_str, handle);

    if(!bt_uuid_cmp(attr->uuid,BT_UUID_GATT_CCC)){

        print_ccc_cfg_data(attr->user_data);
        
    }

    return BT_GATT_ITER_CONTINUE;
}

    static bool my_invalid_uuid(struct bt_uuid *uuid)
{
    bool val =  (bt_uuid_cmp(uuid, BT_UUID_GAP_APPEARANCE) == 0 || bt_uuid_cmp(uuid, BT_UUID_GAP) == 0 ||
    bt_uuid_cmp(uuid, BT_UUID_GATT_SC) == 0);

    char uuid_str[BT_UUID_STR_LEN];
    bt_uuid_to_str(uuid, uuid_str, BT_UUID_STR_LEN);
    
    return val;
}

void my_set_main_conn(struct bt_conn *new_conn){
    main_conn = new_conn;
}

struct bt_conn *my_get_main_conn()
{
    return main_conn;
}

void print_ccc_cfg_data(struct _bt_gatt_ccc *data){
    LOG_DBG("addr of cfg: %p", data);
    for(int i =0; i< 5; i++)
    {
        struct bt_gatt_ccc_cfg *tmp = &data->cfg[i];
        char addr_str[BT_ADDR_LE_STR_LEN];
        bt_addr_le_to_str(&tmp->peer, addr_str, BT_ADDR_LE_STR_LEN);
        LOG_DBG("ccc[%i] addr: %p id: %u, peer: %s, value: %u",i,tmp ,tmp->id, addr_str, tmp->value);
    }
}

ssize_t my_ccc_write_callback(struct bt_conn *conn,
                               const struct bt_gatt_attr *attr, const void *buf,
                               uint16_t len, uint16_t offset, uint8_t flags)
{
    char uuid_str[BT_UUID_STR_LEN];
    bt_uuid_to_str(attr->uuid, uuid_str, BT_UUID_STR_LEN);
    LOG_DBG("writing ccc callback handle: %u, uuid: %s", attr->handle, uuid_str);
    if(!attr->user_data){
        LOG_ERR("ERROR CCC USERDATA");
    }
    struct _bt_gatt_ccc *data = (struct _bt_gatt_ccc *)attr->user_data;
    LOG_DBG("ccc data value:  %u",data->value);
    print_ccc_cfg_data(data);

    ssize_t res = bt_gatt_attr_write_ccc(conn, attr, buf, len, offset, flags);
    print_ccc_cfg_data(data);
    return res;
}

static uint8_t my_ccc_callback(struct bt_conn * conn,
                                   struct bt_gatt_subscribe_params * params,
                                   const void *data, uint16_t len)
{
    LOG_DBG("ATLEAST ONCE");
    if (!data)
    {
        LOG_INF("ccc data error handle %u", params->value_handle);
        return BT_GATT_ITER_STOP;
    }
    LOG_INF("ccc update callback recieved: attribute with handle: %u \n", params->value_handle);
    const struct bt_gatt_attr *tmp_attr = my_db_write_entry(params->value_handle, data, len, false);
    uint16_t tmp_handle = my_get_char_handle(tmp_attr->handle);
    struct bt_gatt_attr *tmp_attr2 = my_db_get_attr(tmp_handle);

    LOG_DBG("attrhandle: %u, attr2handle: %u, tmp_handle %u", tmp_attr->handle, tmp_attr2->handle,tmp_handle);

    char uuid_str[BT_UUID_STR_LEN];
    bt_uuid_to_str(tmp_attr2->uuid, uuid_str, BT_UUID_STR_LEN);
    struct bt_gatt_chrc *tmp_chrc = tmp_attr2->user_data;
    char uuid_str2[BT_UUID_STR_LEN];
    bt_uuid_to_str(tmp_chrc->uuid, uuid_str2, BT_UUID_STR_LEN); 
    LOG_DBG("attr2 uuid: %s, chrc uuid: %s, chrc valuehandle: %u", uuid_str, uuid_str2, tmp_chrc->value_handle);

    bt_gatt_foreach_attr(1,0xffff,tmp_func,NULL);

    #ifdef CHECK_RULES
    if(my_check_rules(1,tmp_attr2->handle)){
        return BT_GATT_ITER_STOP;
    }
    #endif
    int err = bt_gatt_notify(NULL, tmp_attr2, data, len);
    if(err){
        LOG_ERR("gatt notify error: %i", err);
    }

    return BT_GATT_ITER_CONTINUE;
}

int my_adv_subscribe_to_all()
{

    int err = my_subscribe_to_all(main_conn, my_ccc_callback);
    return err;
}

static void my_ccc_changed(const struct bt_gatt_attr *attr, uint16_t value)
{
    LOG_INF("ccc callback: user wants to subscribe to attribute with handle: %u \n", attr->handle);
    /*
    if (value == BT_GATT_CCC_NOTIFY){
        uint16_t value_handle = my_get_char_handle(attr->handle);
        struct bt_gatt_ccc *tmp = attr->user_data;
        struct bt_gatt_subscribe_params sub_params = {
            .ccc_handle = attr->handle,
            .notify = my_ccc_callback,
            .value_handle = value_handle,
            .value = BT_GATT_CCC_NOTIFY,

        };

    }*/
    return;
}

    uint8_t my_read_callback(struct bt_conn * conn, uint8_t err,
                             struct bt_gatt_read_params * params,
                             const void *data, uint16_t length)
    {
        LOG_DBG("writing new value to db, length = %u", length);
        LOG_HEXDUMP_DBG(data, length, "read response callback: attribute with bytes:");

        my_db_write_entry(params->single.handle, data, length, false);
        return BT_GATT_ITER_STOP;
    }

    static size_t my_read_response_callback(struct bt_conn * conn,
                                            const struct bt_gatt_attr *attr,
                                            void *buf, uint16_t len,
                                            uint16_t offset)
    {
        LOG_DBG("trying to read: attribute with handle: %u len: %u\n", attr->handle, len);
        struct bt_conn_info info, main_info;
        bt_conn_get_info(conn, &info);
        bt_conn_get_info(main_conn, &main_info);
        LOG_DBG("conn_id = %u", info.id);
        LOG_DBG("main conn = %u, status = %u", main_info.id, main_info.state);


#ifdef MY_CALLBACK_ATTEMPT
/*     struct bt_gatt_read_params _read_params = {
        .func = my_read_callback,
        .handle_count = 1,
        .single = {
            .handle=attr->handle,
            .offset = 0,
        },
    }; */


   /*  struct bt_gatt_read_params *_read_params = k_malloc(sizeof(struct bt_gatt_read_params));
    memset(_read_params, 0, sizeof(struct bt_gatt_read_params));
    _read_params->func = my_read_callback;
    _read_params->handle_count = 1;
    _read_params->single.handle = attr->handle;
    _read_params->single.offset = 0; 
    int err = bt_gatt_read(main_conn, _read_params);
    */
   int length = 1;
    LOG_DBG("Sent read request!");
    bool wait = false;
    len = my_db_read_entry(attr->handle,buf,len,wait);
    //LOG_DBG("DONE WAITING!, tmp = %p", tmp);
    //memset(buf,0x01,1);
    return length;
#else
    int length = my_db_read_entry(attr->handle, buf, len, false);
    return length;

#endif
}

static void my_write_callback(struct bt_conn *conn, uint8_t err, struct bt_gatt_write_params *params){

    LOG_DBG("empty writecallback triggered");
    return ;
};

static size_t my_write_response_callback(struct bt_conn *conn,
                                const struct bt_gatt_attr *attr,
                                const void *buf, uint16_t len,
                                uint16_t offset, uint8_t flags)
{
    LOG_INF("trying to write: attribute with handle: %u \n", attr->handle);

    if(MY_CHECK_BIT(flags,1)){
        //bt_gatt_write_without_response(main_conn, attr->handle, buf, len,false);
    }else{
        struct bt_gatt_write_params _write_params = {
            .handle = attr->handle,
            .data = buf,
            .length = len,
            .offset = offset,
            .func = my_write_response_callback,
        };
        int err = bt_gatt_write(main_conn, &_write_params);
    }

    return len;
}

static void my_free_user_data(void *user_data){

    k_free(user_data);
}

    static int free_attr_node(struct my_attr_node *attr_node)
{
    LOG_DBG("freeing a node!");
    my_free_user_data(attr_node->attr.user_data);
    k_free(attr_node->attr.uuid);
    k_free(attr_node);
    return 0;
}


static struct my_char_perm check_chrc_perm(uint16_t prop, struct bt_gatt_attr *attr)
{
    uint16_t perm = 0;
    uint16_t new_prop = 0;
    for (int i = 0; i < 16; i++)
    {
        if (MY_CHECK_BIT(prop, i))
        {
            switch (i)
            {
            case 0:
                new_prop |= BT_GATT_CHRC_BROADCAST;
                break;
            case 1:
                new_prop |= BT_GATT_CHRC_READ;
                perm |= BT_GATT_PERM_READ;
                attr->read = my_read_response_callback;
                break;
            case 2:
                new_prop |= BT_GATT_CHRC_WRITE_WITHOUT_RESP;
                perm |= BT_GATT_PERM_WRITE;
                break;
            case 3:
                new_prop |= BT_GATT_CHRC_WRITE;
                perm |= BT_GATT_PERM_WRITE;
                attr->write = my_write_response_callback;
                break;
            case 4:
                new_prop |= BT_GATT_CHRC_NOTIFY;
                break;
            }
        }
    }
    LOG_DBG("char with handle= %u,   perm = %u",attr->handle, perm);
    return (struct my_char_perm){perm,new_prop};
}

static int my_empty_list()
{
    struct my_attr_node *cn, *cns;

    SYS_SLIST_FOR_EACH_CONTAINER_SAFE(&my_attr_list, cn, cns, node)
    {

        free_attr_node(cn);
    }
    sys_slist_init(&my_attr_list);
    atomic_clear(&my_attr_list_ctr);

    return 0;
}

static int flush_attr_list(){

    struct my_attr_node *cn, *cns;
    atomic_val_t val_list_ctr = atomic_get(&my_attr_list_ctr);
    struct bt_gatt_attr *attrs = k_malloc(val_list_ctr * sizeof(struct bt_gatt_attr));

    int i = 0;
    LOG_DBG("\n adding service \n");
    SYS_SLIST_FOR_EACH_CONTAINER_SAFE(&my_attr_list, cn, cns, node)
    {

        char uuid_str[BT_UUID_STR_LEN];
        bt_uuid_to_str(cn->attr.uuid,uuid_str, BT_UUID_STR_LEN);
        LOG_DBG("adding attribute with uuid: %s   , handle: %u \n",uuid_str, cn->attr.handle);
        attrs[i] = cn->attr;

        if(cn->type == VALUE || cn->type == CHARACTERISTIC){
            my_db_add_entry(cn->attr.handle,NULL,cn->len, &attrs[i]);
        }
        i++;
        k_free(cn);
    }
    LOG_DBG("\n service added \n");
    sys_slist_init(&my_attr_list);

    _service = k_malloc(sizeof(struct bt_gatt_service));
    _service->attr_count = atomic_get(&my_attr_list_ctr);
    _service->attrs = attrs;

    int err = bt_gatt_service_register(_service);
    LOG_DBG("err = %d", err);

    atomic_clear(&my_attr_list_ctr);
    //log_panic();
    return 0;
}

static int reset_attr_list()
{
    if(!sys_slist_is_empty(&my_attr_list)){

        bool val = atomic_test_and_clear_bit(&empty_loop, 0);

        if (val)
        {
            my_empty_list();
        }
        else
        {
            flush_attr_list();
        }
    }

    return 0;
}

static struct bt_uuid* my_cpy_uuid(struct bt_uuid *_uuid)
{

    if (_uuid->type == BT_UUID_TYPE_16)
    {
        struct bt_uuid_16 *tmp = k_malloc(sizeof(struct bt_uuid_16));
        memcpy(&tmp->uuid, _uuid, sizeof(struct bt_uuid));
        memcpy(&tmp->val, &BT_UUID_16(_uuid)->val, BT_UUID_SIZE_16);
        return &tmp->uuid;
    }
    else if(_uuid->type == BT_UUID_TYPE_32){
        struct bt_uuid_32 *tmp = k_malloc(sizeof(struct bt_uuid_32));
        memcpy(&tmp->uuid, _uuid, sizeof(struct bt_uuid));
        memcpy(&tmp->val, &BT_UUID_32(_uuid)->val, BT_UUID_SIZE_32);
        return &tmp->uuid;
    }
    else if(_uuid->type == BT_UUID_TYPE_128){
        struct bt_uuid_128 *tmp = k_malloc(sizeof(struct bt_uuid_128));
        memcpy(&tmp->uuid, _uuid, sizeof(struct bt_uuid));
        memcpy(tmp->val, BT_UUID_128(_uuid)->val, BT_UUID_SIZE_128);
        //bt_uuid_create(&tmp->uuid, &BT_UUID_128(_uuid)->val, BT_UUID_SIZE_128);
        return &tmp->uuid;
    }
}

static void * my_cpy_user_data(struct bt_gatt_discover_params *params, void * user_data)
{
    if (params->type == BT_GATT_DISCOVER_PRIMARY || params->type == BT_GATT_DISCOVER_SECONDARY)
    {
        struct bt_gatt_service_val *_data = user_data;
        struct bt_uuid *_uuid = my_cpy_uuid(_data->uuid);
        return _uuid;
    }
    else if(params->type == BT_GATT_DISCOVER_CHARACTERISTIC)
    {
        struct bt_gatt_chrc *_data = user_data;
        struct bt_gatt_chrc *_data_chrc_cpy = k_malloc(sizeof(struct bt_gatt_chrc));
        //memcpy(_data_chrc_cpy, _data, sizeof(struct bt_gatt_chrc));
        
        _data_chrc_cpy->properties = _data->properties;
        _data_chrc_cpy->value_handle = _data->value_handle;
        struct bt_uuid *tmp = my_cpy_uuid(_data->uuid);
        _data_chrc_cpy->uuid = tmp;
        struct bt_uuid_128 *a = BT_UUID_128(_data->uuid);
        struct bt_uuid_128 *b = BT_UUID_128(_data_chrc_cpy->uuid);
        struct bt_uuid_128 *c = BT_UUID_128(tmp);
        return _data_chrc_cpy;
    }
    else if (params->type == BT_GATT_DISCOVER_STD_CHAR_DESC)
    {
        if (bt_uuid_cmp(params->uuid, BT_UUID_GATT_CCC) == 0)
        {
            LOG_DBG("CCC userdata created");
            struct _bt_gatt_ccc *_data = k_malloc(sizeof(struct _bt_gatt_ccc));
            memset(_data,0,sizeof(struct _bt_gatt_ccc));
            _data->cfg_changed = my_ccc_changed;
            _data->cfg_match = NULL;
            _data->cfg_write = NULL;
            LOG_DBG("AT CREATION");
            print_ccc_cfg_data(_data);
            return _data;
        }
        else if (bt_uuid_cmp(params->uuid, BT_UUID_GATT_CEP) == 0)
        {
            return NULL;
        }
        else
        {
            return NULL;
        }
    }
    else
    {
        return NULL;
    }
}

static int my_add_service(struct bt_conn *conn, const struct bt_gatt_attr *attr, struct bt_gatt_discover_params *params)
{

    if (my_invalid_uuid(attr->uuid))
    {
        atomic_set_bit(&empty_loop, 0);
        LOG_DBG("found bad uuid");
        //return 0;
    }
    struct my_attr_node *node = k_malloc(sizeof(struct my_attr_node));

    struct bt_uuid *_uuid = my_cpy_uuid(attr->uuid);
    
    void *_user_data = my_cpy_user_data(params, attr->user_data);

    node->attr.uuid=_uuid;
    node->attr.user_data = _user_data;
    node->attr.handle = attr->handle;
    //node->attr.handle = 0;

    char uuid_str[BT_UUID_STR_LEN];

    if (params->type == BT_GATT_DISCOVER_PRIMARY || params->type == BT_GATT_DISCOVER_SECONDARY)
    {

        node->attr.read = bt_gatt_attr_read_service;
        node->attr.write = NULL;
        node->attr.perm = BT_GATT_PERM_READ;

        struct uuid *ttmp = node->attr.user_data; 
        bt_uuid_to_str(ttmp, uuid_str, sizeof(uuid_str));

        sys_slist_append(&my_attr_list, &node->node);
        atomic_set(&my_attr_list_ctr, 1);

        chrc_params->start_handle = params->start_handle+1;
        chrc_params->end_handle = ((struct bt_gatt_service_val *) attr->user_data)->end_handle;
        
        atomic_inc(&my_sem_counter);
        int err = bt_gatt_discover(conn,chrc_params);

        params->start_handle = ((struct bt_gatt_service_val *)attr->user_data)->end_handle;
        return 0;

    }else if (params->type == BT_GATT_DISCOVER_CHARACTERISTIC)
    {
        node->attr.read = bt_gatt_attr_read_chrc;
        node->attr.write = NULL;
        node->attr.perm = BT_GATT_PERM_READ;
        node->type = CHARACTERISTIC;
        node->len = MY_DEFAULT_LEN;

            struct bt_gatt_chrc *tmp = attr->user_data;

        if (my_invalid_uuid(tmp->uuid))
        {
            atomic_set_bit(&empty_loop, 0);
            free_attr_node(node);
            return 0;
        }

        struct my_attr_node *node2 = k_malloc(sizeof(struct my_attr_node));
        //node2->attr.handle = tmp->value_handle;
        node2->attr.handle = tmp->value_handle;
        node2->attr.read = NULL;
        node2->attr.write = NULL;
        node2->type = VALUE;
        node2->len = MY_DEFAULT_LEN;
        struct my_char_perm tmp_perms = check_chrc_perm(tmp->properties, &node2->attr);
        node2->attr.perm = tmp_perms.perm;
        node2->attr.user_data = NULL;
        node2->attr.uuid = my_cpy_uuid(tmp->uuid);
        sys_slist_append(&my_attr_list, &node->node);
        sys_slist_append(&my_attr_list, &node2->node);
        atomic_add(&my_attr_list_ctr,2);

        //my_add_db_entry(tmp->value_handle, NULL, );

        //DANGER
        ccc_params->start_handle = attr->handle;
        ccc_params->end_handle = params->end_handle;
        atomic_inc(&my_sem_counter);
        int err2 = bt_gatt_discover(conn, ccc_params);
        //END DANGER

        return 0;
    }
    else if (params->type == BT_GATT_DISCOVER_STD_CHAR_DESC)
    {
        if (bt_uuid_cmp(params->uuid, BT_UUID_GATT_CCC) == 0)
        {
            node->attr.perm = (BT_GATT_PERM_READ | BT_GATT_PERM_WRITE);
            node->attr.read = bt_gatt_attr_read_ccc;
            //node->attr.write = my_ccc_write_callback;
            node->attr.write = bt_gatt_attr_write_ccc;

                sys_slist_append(&my_attr_list, &node->node);
            int err = my_add_ccc_entry(attr->handle, params->start_handle);

            atomic_inc(&my_attr_list_ctr);

            LOG_DBG("params->starthandle=%u, attr->handle=%u",params->start_handle, attr->handle);

            return 0;
        }
        else if (bt_uuid_cmp(params->uuid, BT_UUID_GATT_CEP) == 0)
        {
            return -1;
        }
        else
        {
            return -1;
        }
    }

        return 0;
}

static uint8_t my_discover_func(struct bt_conn *conn,
                                const struct bt_gatt_attr *attr,
                                struct bt_gatt_discover_params *params)
{
    if (attr == NULL)
    {

        if (params->type == BT_GATT_DISCOVER_PRIMARY)
        {
            LOG_DBG("discover done \n");
            params->start_handle = UINT16_MAX;
            atomic_dec(&my_sem_counter);
            k_sem_give(&disc_sem);
            return BT_GATT_ITER_STOP;
        } else
        {
            atomic_dec(&my_sem_counter);
            k_sem_give(&disc_sem);
            return BT_GATT_ITER_STOP;
        }
    }
    
    int err = my_add_service(conn, attr, params);

    if (atomic_test_bit(&empty_loop, 0) && params->type != BT_GATT_DISCOVER_PRIMARY)
    {
        atomic_dec(&my_sem_counter);
        k_sem_give(&disc_sem);
        return BT_GATT_ITER_STOP;
    }

    char uuid_str[BT_UUID_STR_LEN];
    bt_uuid_to_str(attr->uuid, uuid_str, BT_UUID_STR_LEN);

    if (err < 0)
    {
        LOG_ERR("cant add service ERROR: %d \n", err);
        return err;
    }
    if (params->type == BT_GATT_DISCOVER_PRIMARY)
    {
        atomic_dec(&my_sem_counter);
        k_sem_give(&disc_sem);
        return BT_GATT_ITER_STOP;
    }
    return BT_GATT_ITER_CONTINUE;
}

int my_start_discovery()
{
    struct bt_gatt_discover_params my_disc_params = 
    {
        .uuid = NULL,
        .type = BT_GATT_DISCOVER_PRIMARY,
        .start_handle = BT_ATT_FIRST_ATTRIBUTE_HANDLE,
        .end_handle = BT_ATT_LAST_ATTRIBUTE_HANDLE,
        .func = my_discover_func,
    };
    struct bt_gatt_discover_params tmp_chrc_params =
    {
        .uuid = NULL,
        .type = BT_GATT_DISCOVER_CHARACTERISTIC,
        .start_handle = BT_ATT_FIRST_ATTRIBUTE_HANDLE,
        .end_handle = BT_ATT_LAST_ATTRIBUTE_HANDLE,
        .func = my_discover_func,
    };
    struct bt_gatt_discover_params tmp_ccc_params =
    {
        .uuid = BT_UUID_GATT_CCC,
        .type = BT_GATT_DISCOVER_STD_CHAR_DESC,
        .start_handle = BT_ATT_FIRST_ATTRIBUTE_HANDLE,
        .end_handle = BT_ATT_LAST_ATTRIBUTE_HANDLE,
        .func = my_discover_func,
    };
    chrc_params = &tmp_chrc_params;
    ccc_params = &tmp_ccc_params;

    if (main_conn != NULL)
    {
        while (my_disc_params.start_handle != UINT16_MAX)
        {
            LOG_DBG("starthandle = %u ", my_disc_params.start_handle);

            atomic_inc(&my_sem_counter);
            int err = bt_gatt_discover(main_conn, &my_disc_params);
            
            do
            {
                k_sem_take(&disc_sem, K_FOREVER);
                
            } while(atomic_get(&my_sem_counter) > 0);

            reset_attr_list();
        }
    }else
    {
        LOG_ERR("failed to set main connection \n");
        return -1;
    }
    k_sem_give(&adv_sem);
    return 0;
}

static void connected(struct bt_conn * conn, uint8_t err)
{
    struct bt_conn_info my_info;

    if (err)
    {
        LOG_ERR("Connection failed (err %u)\n", err);
        return;
    }
    bt_conn_get_info(conn, &my_info);

    char addr[BT_ADDR_LE_STR_LEN];
    bt_addr_le_to_str(bt_conn_get_dst(conn), addr, sizeof(addr));

    LOG_INF("Connected to: %s, id: %u, role: %s \n", addr, my_info.id, (my_info.role == BT_CONN_ROLE_CENTRAL ? "central" : "periphiral"));

    if (my_info.role == BT_CONN_ROLE_CENTRAL)
    {
        main_conn = conn;
        k_sem_give(&adv_sem);
        return;
    }
    else
    {
        return;
    }
}

static void disconnected(struct bt_conn * conn, uint8_t reason)
{
    char addr[BT_ADDR_LE_STR_LEN];
    bt_addr_le_to_str(bt_conn_get_dst(conn), addr, sizeof(addr));
    LOG_INF("Disconnected to : %s (reason %u)\n",addr,reason);
}

BT_CONN_CB_DEFINE(conn_callbacks) = {
    .connected = connected,
    .disconnected = disconnected,
};
```

## src/adv.h
```c
#ifndef MY_ADVERTISMENT
#define MY_ADVERTISMENT
#include <zephyr/sys/slist.h>
#include <zephyr/bluetooth/gatt.h>
#include <zephyr/bluetooth/conn.h>

#define MY_DEFAULT_LEN 1

extern struct k_sem adv_sem;


#define MY_ATTR_LIMIT 2
#define MAX_RULES 5

struct my_rule{
    int new_val;
    uint16_t handle;
    uint8_t dir;
    uint8_t set_new_val;
};

typedef enum
{
    UNDEFINED = 0,
    PRIMARY = 1,
    CHARACTERISTIC = 2,
    CCC = 3,
    VALUE = 4,
} my_attr_type;

struct my_attr_node{
    sys_snode_t node;
    struct bt_gatt_attr attr;
    my_attr_type type;
    uint8_t len;
};

struct my_char_perm{
    uint16_t perm;
    uint16_t prop;
};


int my_start_discovery();
void my_set_main_conn(struct bt_conn *new_conn);
struct bt_conn *my_get_main_conn();
int my_adv_subscribe_to_all();
void print_ccc_cfg_data(struct _bt_gatt_ccc *data);
int my_add_rule(bool dir, uint16_t handle, bool set_new_val, int new_val);

#endif
```

## src/db.c
```c
#include "db.h"
#include <zephyr/logging/log.h>
#include <zephyr/bluetooth/gatt.h>
#include "myutil.h"

LOG_MODULE_DECLARE(log1, APP_LOG_LEVEL);

#define MY_DB_DEFAULT_LEN 4

static sys_slist_t my_db = {NULL, NULL};
static sys_slist_t my_ccc_list = {NULL, NULL};

struct my_rule my_rules[MAX_RULES];
int num_rules = 0;


void print_rule(struct my_rule *rule){

        LOG_INF("rule: \n \t handle: %u, dir: %u, type:%s, new_value: %x",rule->handle,rule->dir,(rule->set_new_val ? "REPLACE":"BLOCK"),\
        (rule->set_new_val ? rule->new_val[0]:0));
}

int my_add_rule(bool dir, uint16_t handle, bool set_new_val, uint8_t *new_val, size_t len)
{

    if (num_rules == MAX_RULES)
    {
        return -1;
    }
    struct my_rule *tmp = &my_rules[num_rules];

    tmp->dir = dir;
    tmp->handle = handle;
    tmp->set_new_val = set_new_val;
    tmp->new_val = new_val;
    tmp->len = len;

    num_rules++;
    LOG_INF("new rule added: ");
    print_rule(tmp);
    return 0;
}

struct my_rule_res my_check_rules(uint8_t dir, uint16_t handle, const void *data, uint16_t len)
{
    struct my_rule_res res = {RULE_PASS,data,len};
    if (!num_rules)
    {
        return res;
    }
    for (int i = 0; i < num_rules; i++)
    {
        struct my_rule *tmp = &my_rules[i];
        print_rule(tmp);
        if (tmp->dir == dir && tmp->handle == handle)
        {
            if(tmp->set_new_val){
                res.type = RULE_REPLACE;
                res.data = tmp->new_val;
                res.len = tmp->len;
                 LOG_HEXDUMP_INF(res.data, res.len, "replacing real data with: ");
            }else{
                res.type = RULE_BLOCK;
            }
            
            return res;
        }
    }
    return res;
}

void my_db_foreach(void (*func)(uint16_t handle, struct bt_gatt_attr *attr, void* user_data),void *data){
    struct my_db_node *cn;
    SYS_SLIST_FOR_EACH_CONTAINER(&my_db, cn, node)
    {
       func(cn->data.handle,cn->data.attr,data);
    }
    return;
}


struct my_db_entry* my_db_add_entry(uint16_t handle, my_entry_type type, struct bt_gatt_attr *attr)
{
    struct my_db_node *node = k_malloc(sizeof(struct my_db_node));
    memset(node,0,sizeof(struct my_db_node));
    struct my_db_entry *entry = &node->data;
    entry->type = type;
    entry->attr = attr;
    entry->handle = handle;

    if (type == ENTRY_PRIMARY)
    {
    }
    else if (type == ENTRY_CCC)
    {
    }
    else if (type == ENTRY_CHARACTERISTIC)
    {
    }
    else if (type == ENTRY_DATA)
    {
        entry->len = MY_DB_DEFAULT_LEN;
        entry->data = k_malloc(entry->len);
        entry->max_len = entry->len;
        k_sem_init(&node->sema,0,1);
        memset(entry->data, 0, entry->len);
    }
    
    sys_slist_append(&my_db, &node->node);
    return entry;
}

int my_db_read_entry(uint16_t handle, void *buffer, uint16_t len, bool wait)
{
    //LOG_DBG("in read db");
    struct my_db_node *cn;
    SYS_SLIST_FOR_EACH_CONTAINER(&my_db, cn, node){
        //LOG_DBG("current handle: %u, looking for handle: %u",cn->data.handle, handle);
        if(cn->data.handle == handle){
            
            #ifdef MY_CALLBACK_ATTEMPT
            int err = 0;
            if (wait)
            {
                LOG_DBG("starting to wait for handle %u ", handle);
                err = k_sem_take(&cn->sema, K_FOREVER);
            }
            #endif

            int length = MIN(cn->data.len, len); 
            memcpy(buffer, cn->data.data, length);
            return length;
        }
    }
    return -1;
}

/* 
    dir > 0 means from user to target
    dir = 0 means from target to user

*/
uint16_t my_db_translate_handle(uint16_t handle, uint8_t dir){
    struct my_db_node *cn;
    SYS_SLIST_FOR_EACH_CONTAINER(&my_db, cn, node){
        if(dir){
            if (cn->data.attr->handle == handle){
                return cn->data.handle;
            }
        }else{
            if(cn->data.handle == handle){
                return cn->data.attr->handle;
            }
        }
    }
    return 0;
}

void my_db_write_entry(uint16_t handle, const void *buffer, uint16_t len, bool wake)
{
    if (!buffer)
    {
        return NULL;
    }

    struct my_db_node *cn;
    SYS_SLIST_FOR_EACH_CONTAINER(&my_db, cn, node)
    {

        if (cn->data.handle == handle)
        {
            LOG_DBG("writing to db, handle: %u, first byte value: %x",cn->data.handle,((uint8_t *)buffer)[0]);
            if (len > cn->data.max_len){
                k_free(cn->data.data);
                cn->data.data = k_malloc(len);
                cn->data.max_len = len;
            }
            cn->data.len = len;
            memcpy(cn->data.data, buffer, len);
            
            #ifdef MY_CALLBACK_ATTEMPT
            if(wake){
                LOG_DBG("waking handle %u", handle);
                k_sem_give(&cn->sema);
            }
            #endif
            return cn->data.attr;
        }
    }

    return NULL;
}

int my_db_remove_entry(uint16_t handle)
{

    return 0;
}

int my_db_wait_for_entry(uint16_t handle)
{
    struct my_db_node *cn;
    SYS_SLIST_FOR_EACH_CONTAINER(&my_db, cn, node)
    {

        if (cn->data.handle == handle)
        {
            int err = k_sem_take(&cn->sema,K_FOREVER);
            return err;
        }
    }

    return -1;
}

struct my_db_entry * my_db_get_entry(uint16_t handle){

    struct my_db_node *cn;
    SYS_SLIST_FOR_EACH_CONTAINER(&my_db, cn, node)
    {

        if (cn->data.handle == handle)
        {
            return &cn->data;
        }
    }
    return NULL;
}

size_t my_db_get_entry_data(struct my_db_entry *entry, void *buf, uint16_t len){

    uint16_t _len = MIN(len,entry->len);
    memcpy(buf, entry->data,_len);
    return _len;
}

int my_db_set_data_ptr(struct my_db_entry *entry1, struct my_db_entry *entry2){

    entry1->data=entry2;
}

struct my_db_entry *my_db_ccc_to_value_handle(uint16_t ccc_handle)
{
    struct my_db_node *cn;
    SYS_SLIST_FOR_EACH_CONTAINER(&my_db, cn, node)
    {

        if (cn->data.handle == ccc_handle)
        {
            if(cn->data.type !=ENTRY_CCC){
                LOG_ERR("entry at handle %u is not a ccc",ccc_handle);
                return NULL;
            }

            struct my_db_entry *value_ptr = cn->data.data;
            return value_ptr->data;
        }
    }
}

static void my_clean_sub_param(struct bt_gatt_subscribe_params *params){

    //k_free(params);
    return;
}

    void my_sub_callback(struct bt_conn *conn, uint8_t err,
                         struct bt_gatt_subscribe_params *params)
{
    LOG_DBG("sub_callback response with err: %u, char_handle = %u, ccc_handle = %u, notification value = %u",err,params->value_handle, params->ccc_handle, params->value);
    //my_clean_sub_param(params);
    LOG_INF("MITM module ready");
    return;
}

void my_db_translate_chrc_user_data(){
    struct my_db_node *cn;
    SYS_SLIST_FOR_EACH_CONTAINER(&my_db, cn, node)
    {
        if(cn->data.type == ENTRY_CHARACTERISTIC){
            struct bt_gatt_chrc *tmp = cn->data.attr->user_data;
            
            struct my_db_entry *entry = my_db_get_entry(tmp->value_handle);
            uint16_t tmp_uint = entry->attr->handle;
            tmp->value_handle = tmp_uint;
        }
    }
}

void my_db_print_entries(){

    struct my_db_node *cn;
    SYS_SLIST_FOR_EACH_CONTAINER(&my_db, cn, node)
    {
        struct my_db_entry *entry = &cn->data;
        char uuid_str[BT_UUID_STR_LEN];
        bt_uuid_to_str(entry->attr->uuid,uuid_str,sizeof(uuid_str));
        LOG_DBG("uuid: %s target_handle: %u, user_handle: %u", uuid_str, entry->handle, entry->attr->handle);
    }
}

    /*
    int my_subscribe_to_all(struct bt_conn *conn, bt_gatt_subscribe_func_t func){

        if(!conn){
            LOG_ERR("NO CONNN!");
            return -1;
        }

        struct my_ccc_node *cn;

            LOG_DBG("found ccc thing with ccc_handle: %u, char_handle: %u value_handle %u",cn->data.ccc_handle, cn->data.char_handle, cn->data.value_handle);
            struct bt_gatt_subscribe_params params;
            sub_param->ccc_handle = ccc_handle;
            sub_param->value_handle = cn->data.value_handle;
            sub_param->value = BT_GATT_CCC_NOTIFY;
            sub_param->notify = func;
            sub_param->subscribe = my_sub_callback;

            int err = bt_gatt_subscribe(conn, sub_param);

            if(err){
                LOG_DBG("ERROR IN THE SUBLOOP!");
            }




        return 0;
    }*/
```

## src/db.h
```c
#ifndef MY_DB
#define MY_DB

#include <zephyr/sys/slist.h>
#include <zephyr/bluetooth/gatt.h>
#include <zephyr/kernel.h>

#define MAX_RULES 5

typedef enum
{
    RULE_PASS = 0,
    RULE_BLOCK = 1,
    RULE_REPLACE = 2,
} my_rule_res_type;

typedef enum
{
    ENTRY_PRIMARY,
    ENTRY_CHARACTERISTIC,
    ENTRY_CCC,
    ENTRY_DATA,
} my_entry_type;

struct my_rule
{
    uint8_t *new_val;
    uint16_t len;
    uint16_t handle;
    uint8_t dir;
    uint8_t set_new_val;
};

struct my_rule_res
{
    my_rule_res_type type;
    uint8_t *data;
    uint16_t len;
};

struct my_db_entry
{
    uint16_t handle;
    uint16_t type;
    int len;
    int max_len;
    void *data;
    struct bt_gatt_attr *attr;
};

struct my_db_node
{
    struct my_db_entry data;
    sys_snode_t node;
    struct k_sem sema;
    
};

struct my_db_entry *my_db_add_entry(uint16_t handle, my_entry_type type, struct bt_gatt_attr *attr);
void my_db_write_entry(uint16_t handle, const void *buffer, uint16_t len, bool wake);
int my_db_read_entry(uint16_t handle, void *buffer, uint16_t len, bool wait);
int my_db_remove_entry(uint16_t handle);
int my_db_wait_for_entry(uint16_t handle);
struct my_db_entry* my_db_get_entry(uint16_t handle);
int my_db_set_data_ptr(struct my_db_entry *entry1, struct my_db_entry *entry2);
int my_subscribe_to_all(struct bt_conn *conn, bt_gatt_subscribe_func_t func);
void my_db_foreach(void (*func)(uint16_t handle, struct bt_gatt_attr *attr, void *user_data), void *data);
int my_add_rule(bool dir, uint16_t handle, bool set_new_val, uint8_t *new_val, size_t len);
struct my_rule_res my_check_rules(uint8_t dir, uint16_t handle, const void *data, uint16_t len);
struct my_db_entry *my_db_ccc_to_value_handle(uint16_t ccc_handle);
uint16_t my_db_translate_handle(uint16_t handle, uint8_t dir);
size_t my_db_get_entry_data(struct my_db_entry *entry,void *buf, uint16_t len);
void my_db_translate_chrc_user_data();
void my_db_print_entries();

#endif
```

## src/mitm.h
```c
#ifndef MY_MITM
#define MY_MITM

#define NAME_LEN 30
#include <stdbool.h>
#include <zephyr/bluetooth/addr.h>
#include <zephyr/kernel.h>
#include <zephyr/sys/slist.h>
#include <zephyr/bluetooth/uuid.h>
#include <zephyr/bluetooth/bluetooth.h>
#include <zephyr/bluetooth/conn.h>
#include "myutil.h"

#define MY_MITM_AD_WAIT_LIMIT 15

extern struct k_sem target_sem;

struct my_mitm_info {
    char name[NAME_LEN];
    uint8_t name_len;
    bool ext_adv;
    bool fullname;
    bool coded_phy;
    bt_addr_le_t addr;
    uint8_t ad_type;
    uint8_t flags;
    uint8_t man_data;
    uint8_t phy1,phy2;
    //char phy1[20], phy2[20];
    char addr_str[BT_ADDR_LE_STR_LEN];
    struct bt_uuid_128 uuid128;
    struct bt_uuid_32 uuid32;
    struct bt_uuid_16 uuid16;
    sys_slist_t ad_slist;
    sys_slist_t sd_slist;
    int nr_ad_fields;
    int nr_sd_fields;
    unsigned long ad_map;
    unsigned long sd_map;
    unsigned int ad_amount;
    unsigned int sd_amount;
    unsigned int address_id;
    bool is_coded;
    uint16_t appearance;
    unsigned int passkey;
    struct bt_le_conn_param conn_param;
    struct bt_conn_le_create_param create_param;
};

    struct my_callback_struct
{
    struct my_mitm_info *mitm_info;
    bool is_sr;
};

struct my_node{
    sys_snode_t node;
    struct bt_data data;
};


extern struct my_mitm_info target_mitm_info;

bool get_my_target_set();
bool get_my_mitm_started();
int my_activate_mitm();
const bt_addr_le_t* get_my_target();
int set_my_target(const char *target, const char* type);
void set_my_target_set(bool value);
void my_mitm_set_appearance(uint16_t appearance);
void my_print_mitm_info(const struct my_mitm_info *mitm_info);
int my_mitm_add_ad(uint8_t type,void *data, uint8_t data_len, bool is_sd, bool is_bt_data);
int my_mitm_start_ad();
void my_set_mitm_bit(bool is_sr, uint8_t type);
int my_init_mitm();
int my_fill_array(sys_slist_t *my_slist, struct bt_data *data);
unsigned long my_set_bit(unsigned long map, uint8_t bit);
bool my_check_bit(unsigned long map, uint8_t bit);
bool my_mitm_get_is_coded();
void my_mitm_set_passkey_c(const char *passkey, size_t len);
unsigned int my_mitm_get_passkey();

#endif
```

## src/my_adv.h
```c
#ifndef MY_ADVERTISMENT
#define MY_ADVERTISMENT
#include <zephyr/sys/slist.h>
#include <zephyr/bluetooth/gatt.h>
#include <zephyr/bluetooth/conn.h>

#define MY_DEFAULT_LEN 1

extern struct k_sem adv_sem;


#define MY_ATTR_LIMIT 2

typedef enum
{
    UNDEFINED = 0,
    PRIMARY = 1,
    CHARACTERISTIC = 2,
    CCC = 3,
    VALUE = 4,
} my_attr_type;

struct my_attr_node{
    sys_snode_t node;
    struct bt_gatt_attr attr;
    my_attr_type type;
    uint8_t len;
};

struct my_char_perm{
    uint16_t perm;
    uint16_t prop;
};


int my_start_discovery();
void my_set_main_conn(struct bt_conn *new_conn);
struct bt_conn *my_get_main_conn();
int my_adv_subscribe_to_all();
void print_ccc_cfg_data(struct _bt_gatt_ccc *data);
int my_adv_wait_for_appearance();
struct bt_conn *my_adv_get_conn(uint32_t id);
int my_adv_reconnect(uint32_t id);

#endif
```

## src/my_uart.h
```c
#ifndef MY_UART
#define MY_UART

extern struct k_msgq uart_msgq;
#define UART_MSG_SIZE 64
#define MY_SEND
#define MY_RECEIVE

int my_uart_init();
void print_uart(char *buf);

#endif
```

## src/myutil.h
```c
#ifndef MYUTIL
#define MYUTIL
#define APP_LOG_LEVEL 3

#include <zephyr/types.h>

#define MY_CHECK_BIT(__u, __n) ((__u) & (1UL << (__n)))
#define MY_SET_BIT(__u, __n) ((__u) | (1UL << __n))

uint32_t my_str_to_uint(char *buf, size_t max_len);

int my_naive_pow(int x, int n);

#endif
```
